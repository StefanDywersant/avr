/**
 * Sentinel
 * Multi-aquarium controller.
 *
 * Copyright: (c) 2010 by Karol Maciaszek
 * E-mail   : <karol.maciaszek@gmail.com>
 * WWW      : http://www.czystybeton.pl/
 *
 * $Id$
 */

#include <avr/pgmspace.h>
#include "debug.h"


#define SHIFT_L(x, pos)		(x << (pos)) + ((x & (0xffff << (16 - (pos)))) >> (16 - (pos)))
#define SHIFT_R(x, pos)		(x >> (pos)) + ((x & (0xffff >> (16 - (pos)))) << (16 - (pos)))
#define MOD(x, mod)			(uint8_t)(x) % (mod)


// PI 256-byte expansion
static uint8_t pi[256] PROGMEM = {
	0xd9, 0x78, 0xf9, 0xc4, 0x19, 0xdd, 0xb5, 0xed, 0x28, 0xe9, 0xfd, 0x79, 0x4a, 0xa0, 0xd8, 0x9d,
	0xc6, 0x7e, 0x37, 0x83, 0x2b, 0x76, 0x53, 0x8e, 0x62, 0x4c, 0x64, 0x88, 0x44, 0x8b, 0xfb, 0xa2,
	0x17, 0x9a, 0x59, 0xf5, 0x87, 0xb3, 0x4f, 0x13, 0x61, 0x45, 0x6d, 0x8d, 0x09, 0x81, 0x7d, 0x32,
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	0xc5, 0xf3, 0xdb, 0x47, 0xe5, 0xa5, 0x9c, 0x77, 0x0a, 0xa6, 0x20, 0x68, 0xfe, 0x7f, 0xc1, 0xad
};


// expanded key
static uint8_t key[128];

// position of last expanded key read
static uint8_t key_pos;


void mix_up(uint16_t* block) {
	uint8_t i;

	for (i = 0; i < 4; i++) {
		block[i] = (uint16_t)(
				block[i]
				+ ((uint16_t*)key)[key_pos]
				+ (block[MOD(i - 1, 4)] & block[MOD(i - 2, 4)])
				+ ((~block[MOD(i - 1, 4)]) & block[MOD(i - 3, 4)]));

		key_pos = (key_pos + 1) % 64;

		if (i == 3)
			block[i] = SHIFT_L(block[i], 5);
		else
			block[i] = SHIFT_L(block[i], i + 1);
	}
}


void r_mix_up(uint16_t* block) {
	uint8_t i;

	for (i = 3; i != 255; i--) {
		if (i == 3)
			block[i] = SHIFT_R(block[i], 5);
		else
			block[i] = SHIFT_R(block[i], i + 1);

		block[i] = (uint16_t)(
				block[i]
				- ((uint16_t*)key)[key_pos]
				- (block[MOD(i - 1, 4)] & block[MOD(i - 2, 4)])
				- ((~block[MOD(i - 1, 4)]) & block[MOD(i - 3, 4)]));

		key_pos = (uint8_t)(key_pos - 1) % 64;
	}
}


void mash_up(uint16_t* block) {
	uint8_t i;

	for (i = 0; i < 4; i++)
		block[i] = block[i] + ((uint16_t*)key)[block[MOD(i - 1, 4)] & 63];
}


void r_mash_up(uint16_t* block) {
	uint8_t i;

	for (i = 3; i != 255; i--)
		block[i] = block[i] - ((uint16_t*)key)[block[MOD(i - 1, 4)] & 63];
}


static void encrypt_block(uint8_t* block) {
	uint8_t i;

	key_pos = 0;

	// 5 x mix up
	for (i = 0; i < 5; i++)
		mix_up((uint16_t*)block);

	// 1 x mash up
	mash_up((uint16_t*)block);

	// 6 x mix up
	for (i = 0; i < 6; i++)
		mix_up((uint16_t*)block);

	// 1 x mash up
	mash_up((uint16_t*)block);

	// 5 x mix up
	for (i = 0; i < 5; i++)
		mix_up((uint16_t*)block);
}


static void decrypt_block(uint8_t* block) {
	uint8_t i;

	key_pos = 63;

	// 5 x mixup
	for (i = 0; i < 5; i++)
		r_mix_up((uint16_t*)block);

	// 1 x mashup
	r_mash_up((uint16_t*)block);

	// 6 x mixup
	for (i = 0; i < 6; i++)
		r_mix_up((uint16_t*)block);

	// 1 x mashup
	r_mash_up((uint16_t*)block);

	// 5 x mixup
	for (i = 0; i < 5; i++)
		r_mix_up((uint16_t*)block);
}


void rc2_set_key(uint8_t* k) {
	uint8_t i;

	// fill in beginning of expanded key
	for (i = 0; i < 8; i++)
		key[i] = k[i];

	// step 1
	for (i = 8; i < 128; i++)
		key[i] = pgm_read_byte(&pi[(uint8_t)(key[i - 1] + key[i - 8])]);

	// step 2
	key[120] = pgm_read_byte(&pi[key[120]]);

	// step 3
	for (i = 119; i != 255; i--)
		key[i] = pgm_read_byte(&pi[key[i + 1] ^ key[i + 8]]);
}


void rc2_encrypt(uint8_t len, uint8_t* payload) {
	uint8_t i;

	// encrypt each of 64bit blocks
	for (i = 0; i < (uint8_t)(len / 8); i++)
		encrypt_block((uint8_t*)&payload[i * 8]);
}


void rc2_decrypt(uint8_t len, uint8_t* payload) {
	uint8_t i;

	// decrypt each of 64bit blocks
	for (i = 0; i < (uint8_t)(len / 8); i++)
		decrypt_block((uint8_t*)&payload[i * 8]);
}
